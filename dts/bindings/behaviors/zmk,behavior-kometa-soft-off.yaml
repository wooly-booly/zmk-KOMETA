## dts/bindings/behaviors/zmk,behavior-kometa-soft-off.yaml
```yaml
description: Soft off after all keys on the local half are released
compatible: "zmk,behavior-kometa-soft-off"
include: zero_param.yaml
```
